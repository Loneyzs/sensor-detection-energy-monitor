## boards/seekfree/energy_mspm0g3507/Kconfig.energy_mspm0g3507
```kconfig
config BOARD_ENERGY_MSPM0G3507
	select SOC_MSPM0G3507
	select HAS_SEGGER_RTT if ZEPHYR_SEGGER_MODULE
```

## boards/seekfree/energy_mspm0g3507/board.yml
```yaml
board:
  name: energy_mspm0g3507
  full_name: SEEKFREE MSPM0G3507 CoreBoard and MotherBoard Energy Monitor
  vendor: seekfree
  socs:
    - name: mspm0g3507
```

## boards/seekfree/energy_mspm0g3507/energy_mspm0g3507_defconfig
```kconfig
CONFIG_GPIO=y
CONFIG_GPIO_HOGS=y
CONFIG_SERIAL=y
CONFIG_CONSOLE=y
CONFIG_UART_CONSOLE=y
CONFIG_CLOCK_CONTROL=y
```
